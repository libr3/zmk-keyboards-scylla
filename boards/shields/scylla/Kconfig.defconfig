## boards/shields/scylla/Kconfig.defconfig
```kconfig
if SHIELD_SCYLLA_DONGLE

    config ZMK_KEYBOARD_NAME
        default "Scylla"

endif

if SHIELD_SCYLLA_LEFT || SHIELD_SCYLLA_RIGHT || SHIELD_SCYLLA_DONGLE

    config ZMK_SPLIT
        default y

    config ZMK_STUDIO
        default y

    config ZMK_BATTERY_REPORTING
        default y

endif
```
